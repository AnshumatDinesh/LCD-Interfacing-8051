ORG 0000H
	SJMP MAIN
//LCD INTERFACING CODE
//P3.0 RS
//P3.1 E
//P2 DATA
ORG 0035H
	MAIN:
		ACALL DELAY_MILLI
		ACALL LCD_INIT
		MOV A,#'A'
		ACALL LCD_PRINT
		MOV A,#'N'
		ACALL LCD_PRINT
		MOV A,#'S'
		ACALL LCD_PRINT
		MOV A,#'H'
		ACALL LCD_PRINT
		MOV A,#'U'
		ACALL LCD_PRINT
		MOV A,#'M'
		ACALL LCD_PRINT
		MOV A,#'A'
		ACALL LCD_PRINT
		MOV A,#'T'
		ACALL LCD_PRINT
		ACALL LCD_SECOND
		MOV A,#'D'
		ACALL LCD_PRINT
		MOV A,#'I'
		ACALL LCD_PRINT
		MOV A,#'N'
		ACALL LCD_PRINT
		MOV A,#'E'
		ACALL LCD_PRINT
		MOV A,#'S'
		ACALL LCD_PRINT
		MOV A,#'H'
		ACALL LCD_PRINT
		WAIT_INF:JMP WAIT_INF
ORG 0100H
	DELAY_MILLI:
		MOV TMOD,#01H//TIMER 0 IN MODE 1
		MOV TH0,#0FCH
		MOV TL0,#18H//1  MILLISECOND DELAY
		SETB TR0
			WAIT_1MS:JNB TF0,WAIT_1MS
		CLR TF0
		CLR TR0
		RET 
	LCD_INIT:
		MOV A,#38H//2 LINES MODE
		ACALL LCD_COMMAND
		MOV A,#0CH//DISPLAY ON
		ACALL LCD_COMMAND
		MOV A,#01H//CLEAR DISPLAY
		ACALL LCD_COMMAND
		MOV A,#80H//FORCE TO FIRST LINE
		ACALL LCD_COMMAND
		RET
	LCD_COMMAND:
			MOV P2,A
			CLR P3.0
			SETB P3.1
			ACALL DELAY_MILLI
			CLR P3.1
			RET
	LCD_PRINT:
			MOV P2,A
			SETB P3.0
			SETB P3.1
			ACALL DELAY_MILLI
			CLR P3.1
			RET
	LCD_PRINTS:
			MOV R0,A
			LOOP:MOV A,@R0
			ACALL LCD_PRINT
			INC R0
			CJNE R0,#00H,LOOP
			RET
	LCD_CLEAR:
		MOV A,#01H
		ACALL LCD_COMMAND
		RET
	LCD_FIRST:
		MOV A,#80H
		ACALL LCD_COMMAND
		RET
	LCD_SECOND:
			MOV A,#0C0H
			ACALL LCD_COMMAND
			RET
		
	
END
	